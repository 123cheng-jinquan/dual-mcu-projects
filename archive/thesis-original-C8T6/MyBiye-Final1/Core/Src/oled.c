#include "oled.h"
#include "i2c.h"
#include <string.h>

#define OLED_I2C_ADDR        0x78
#define OLED_WIDTH           128
#define OLED_HEIGHT          64
#define OLED_PAGES           8

static uint8_t OLED_GRAM[OLED_PAGES][OLED_WIDTH];

static const uint8_t OLED_Font6x8[][6] = {
    {0x00,0x00,0x00,0x00,0x00,0x00}, /* space */
    {0x00,0x00,0x5F,0x00,0x00,0x00}, /* ! */
    {0x00,0x07,0x00,0x07,0x00,0x00}, /* " */
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    {0x10,0x08,0x08,0x10,0x08,0x00}  /* ~ */
};

static void OLED_WriteCommand(uint8_t cmd)
{
    uint8_t data[2];
    data[0] = 0x00;
    data[1] = cmd;
    HAL_I2C_Master_Transmit(&hi2c1, OLED_I2C_ADDR, data, 2, 100);
}

static void OLED_WriteData(uint8_t *data, uint16_t size)
{
    uint8_t buf[17];
    uint16_t offset = 0;
    uint8_t chunk;

    while (offset < size)
    {
        chunk = (size - offset > 16U) ? 16U : (uint8_t)(size - offset);
        buf[0] = 0x40;
        memcpy(&buf[1], &data[offset], chunk);
        HAL_I2C_Master_Transmit(&hi2c1, OLED_I2C_ADDR, buf, chunk + 1U, 100);
        offset += chunk;
    }
}

void OLED_SetCursor(uint8_t page, uint8_t column)
{
    OLED_WriteCommand(0xB0 + page);
    OLED_WriteCommand(0x10 | ((column & 0xF0) >> 4));
    OLED_WriteCommand(0x00 | (column & 0x0F));
}

void OLED_Refresh(void)
{
    uint8_t page;
    for (page = 0; page < OLED_PAGES; page++)
    {
        OLED_SetCursor(page, 0);
        OLED_WriteData(OLED_GRAM[page], OLED_WIDTH);
    }
}

void OLED_Clear(void)
{
    memset(OLED_GRAM, 0x00, sizeof(OLED_GRAM));
    OLED_Refresh();
}

void OLED_ShowChar(uint8_t page, uint8_t column, char chr)
{
    uint8_t index;
    if (chr < 32 || chr > 126)
    {
        chr = '?';
    }
    index = (uint8_t)(chr - 32);

    if (page >= OLED_PAGES || column > OLED_WIDTH - 6)
    {
        return;
    }

    memcpy(&OLED_GRAM[page][column], OLED_Font6x8[index], 6);
}

void OLED_ShowString(uint8_t page, uint8_t column, const char *str)
{
    while (*str != '\0')
    {
        if (column > OLED_WIDTH - 6)
        {
            column = 0;
            page++;
        }
        if (page >= OLED_PAGES)
        {
            break;
        }
        OLED_ShowChar(page, column, *str++);
        column += 6;
    }
    OLED_Refresh();
}

void OLED_ShowNum(uint8_t page, uint8_t column, uint32_t num, uint8_t len)
{
    char buf[12];
    snprintf(buf, sizeof(buf), "%*lu", len, (unsigned long)num);
    OLED_ShowString(page, column, buf);
}

void OLED_Init(void)
{
    HAL_Delay(100);

    OLED_WriteCommand(0xAE);
    OLED_WriteCommand(0xD5);
    OLED_WriteCommand(0x80);
    OLED_WriteCommand(0xA8);
    OLED_WriteCommand(0x3F);
    OLED_WriteCommand(0xD3);
    OLED_WriteCommand(0x00);
    OLED_WriteCommand(0x40);
    OLED_WriteCommand(0xA1);
    OLED_WriteCommand(0xC8);
    OLED_WriteCommand(0xDA);
    OLED_WriteCommand(0x12);
    OLED_WriteCommand(0x81);
    OLED_WriteCommand(0xCF);
    OLED_WriteCommand(0xD9);
    OLED_WriteCommand(0xF1);
    OLED_WriteCommand(0xDB);
    OLED_WriteCommand(0x30);
    OLED_WriteCommand(0xA4);
    OLED_WriteCommand(0xA6);
    OLED_WriteCommand(0x8D);
    OLED_WriteCommand(0x14);
    OLED_WriteCommand(0xAF);

    OLED_Clear();
}
